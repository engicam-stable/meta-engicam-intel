## conf/layer.conf
```bitbake
# We have a conf and classes directory, add to BBPATH
BBPATH .= ":${LAYERDIR}"

# We have recipes-* directories, add to BBFILES
BBFILES += "${LAYERDIR}/recipes-*/*/*.bb \
            ${LAYERDIR}/recipes-*/*/*.bbappend"

BBFILE_COLLECTIONS += "meta-engicam-intel"
BBFILE_PATTERN_meta-engicam-intel = "^${LAYERDIR}/"
BBFILE_PRIORITY_meta-engicam-intel = "7"

LAYERDEPENDS_meta-engicam-intel = "intel"
LAYERSERIES_COMPAT_meta-engicam-intel = "kirkstone"
```

## conf/machine/smarcore-ehl-rt.conf
```bitbake
#@TYPE: Machine
#@NAME: smarcore-ehl

#@DESCRIPTION: Machine configuration for Engicam smarcore-ehl SOM with realtime kernel

PREFERRED_PROVIDER_virtual/kernel = "linux-intel-rt"
PREFERRED_VERSION_linux-intel-rt = "5.15%"

MACHINE_ESSENTIAL_EXTRA_RDEPENDS:append = "${@bb.utils.contains('MACHINE_FEATURES', 'can', ' can-utils python3-can libsocketcan', '', d)}"
KERNEL_FEATURES:append = "${@bb.utils.contains('MACHINE_FEATURES', 'can', ' ehl-can.scc', '', d)}"

require conf/machine/include/engicam-common-64.inc
```

## conf/machine/smarcore-ehl.conf
```bitbake
#@TYPE: Machine
#@NAME: smarcore-ehl

#@DESCRIPTION: Machine configuration for Engicam smarcore-ehl SOM

PREFERRED_VERSION_linux-intel = "5.15%"

MACHINE_ESSENTIAL_EXTRA_RDEPENDS:append = "${@bb.utils.contains('MACHINE_FEATURES', 'can', ' can-utils python3-can libsocketcan', '', d)}"
KERNEL_FEATURES:append = "${@bb.utils.contains('MACHINE_FEATURES', 'can', ' ehl-can.scc', '', d)}"

require conf/machine/include/engicam-common-64.inc
```
